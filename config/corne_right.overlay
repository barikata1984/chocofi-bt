/*
 * Remove D21 (P0.31/AIN7) from col-gpios to verify it has no
 * key switch connected on the Chocofi PCB.
 * col-offset shifts from 6 to 7 to keep matrix column numbers
 * aligned with the five_column_transform.
 */

&kscan0 {
    col-gpios
        = <&pro_micro 20 GPIO_ACTIVE_HIGH>
        , <&pro_micro 19 GPIO_ACTIVE_HIGH>
        , <&pro_micro 18 GPIO_ACTIVE_HIGH>
        , <&pro_micro 15 GPIO_ACTIVE_HIGH>
        , <&pro_micro 14 GPIO_ACTIVE_HIGH>
        ;
};

&default_transform {
    col-offset = <7>;
};

&five_column_transform {
    col-offset = <7>;
};
